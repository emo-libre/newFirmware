## APP - template/sdkconfig.defaults
```kconfig
# ELF App Template — sdkconfig.defaults
# These settings apply to the ELF app build, NOT the base firmware.

# TODO: set your target chip (esp32s3 / esp32 / esp32s2 / esp32c6)
CONFIG_IDF_TARGET="esp32s3"

# PSRAM — must match the base firmware hardware config.
# Remove this block entirely if your board has no PSRAM.
CONFIG_SPIRAM=y
CONFIG_SPIRAM_MODE_OCT=y
CONFIG_SPIRAM_TYPE_AUTO=y
CONFIG_SPIRAM_CLK_IO=30
CONFIG_SPIRAM_CS_IO=26
CONFIG_SPIRAM_SPEED_40M=y
CONFIG_SPIRAM_BOOT_HW_INIT=y
CONFIG_SPIRAM_BOOT_INIT=y
CONFIG_SPIRAM_IGNORE_NOTFOUND=y
CONFIG_SPIRAM_USE_MALLOC=y
CONFIG_SPIRAM_MALLOC_ALWAYSINTERNAL=16384
CONFIG_SPIRAM_MALLOC_RESERVE_INTERNAL=32768
CONFIG_ESP32S3_SPIRAM_SUPPORT=y

# ELF Loader
CONFIG_ELF_LOADER=y
CONFIG_ELF_LOADER_BUS_ADDRESS_MIRROR=y
CONFIG_ELF_LOADER_CACHE_OFFSET=y
CONFIG_ELF_LOADER_LOAD_PSRAM=y
CONFIG_ELF_LOADER_LIBC_SYMBOLS=y
CONFIG_ELF_LOADER_ESPIDF_SYMBOLS=y
# Customer symbols are provided at runtime by the base firmware
# CONFIG_ELF_LOADER_CUSTOMER_SYMBOLS is not set

# Smaller binary
CONFIG_COMPILER_OPTIMIZATION_SIZE=y
```
